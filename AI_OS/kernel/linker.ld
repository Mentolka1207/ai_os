/* =============================================================================
 * AI_OS — Linker Script для ядра
 * File: kernel/linker.ld
 * Desc: Размещает ядро начиная с 1 MiB (0x100000) — стандарт для x86_64 ОС.
 *       Секция .multiboot2 идёт ПЕРВОЙ, чтобы GRUB нашёл заголовок.
 * ============================================================================= */

ENTRY(_start)

SECTIONS
{
    /* Ядро загружается по физическому адресу 1 MiB */
    . = 1M;

    /* -------------------------------------------------------------------------
     * .text — исполняемый код
     * Первой идёт .multiboot2 — GRUB ищет сигнатуру в первых 32 KiB
     * ------------------------------------------------------------------------- */
    .text BLOCK(4K) : ALIGN(4K)
    {
        *(.multiboot2)      /* Multiboot2 заголовок — ОБЯЗАТЕЛЬНО первым */
        *(.text)            /* Весь остальной код */
        *(.text.*)
    }

    /* -------------------------------------------------------------------------
     * .rodata — константы только для чтения (строки, таблицы)
     * ------------------------------------------------------------------------- */
    .rodata BLOCK(4K) : ALIGN(4K)
    {
        *(.rodata)
        *(.rodata.*)
    }

    /* -------------------------------------------------------------------------
     * .data — инициализированные глобальные переменные
     * ------------------------------------------------------------------------- */
    .data BLOCK(4K) : ALIGN(4K)
    {
        *(.data)
        *(.data.*)
    }

    /* -------------------------------------------------------------------------
     * .bss — неинициализированные данные (стек, буферы)
     * В ELF-бинарнике не занимает место — загрузчик обнуляет сам
     * ------------------------------------------------------------------------- */
    .bss BLOCK(4K) : ALIGN(4K)
    {
        *(COMMON)
        *(.bss)
        *(.bss.*)
    }

    /* -------------------------------------------------------------------------
     * Символ конца ядра — удобен для аллокатора памяти
     * ------------------------------------------------------------------------- */
    kernel_end = .;
}
